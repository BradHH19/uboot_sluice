## board/automic/mx6ul_14x14_automic/Kconfig
```kconfig
if TARGET_MX6UL_14X14_AUTOMIC || TARGET_MX6UL_9X9_AUTOMIC

config SYS_BOARD
	default "mx6ul_14x14_automic"

config SYS_VENDOR
	default "automic"

config SYS_CONFIG_NAME
	default "mx6ul_14x14_automic"

config SYS_TEXT_BASE
	default 0x87800000
endif
```

## board/automic/mx6ull_sluice/Kconfig
```kconfig
if TARGET_MX6ULL_14X14_SLUICE || TARGET_MX6ULL_9X9_SLUICE

config SYS_BOARD
	default "mx6ull_sluice"

config SYS_VENDOR
	default "automic"

config SYS_CONFIG_NAME
	default "mx6ull_sluice"

config SYS_TEXT_BASE
	default 0x87800000
endif
```
